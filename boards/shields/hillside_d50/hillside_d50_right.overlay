#include "hillside_d50.dtsi"

// Shift the right 6 columns over as the left half is 6 columns wide.
&default_transform {
    col-offset = <5>;
};

&kscan0 {
    col-gpios
        = <&gpio0 9 GPIO_ACTIVE_HIGH> 
        , <&gpio0 10 GPIO_ACTIVE_HIGH> 
        , <&gpio1 11 GPIO_ACTIVE_HIGH> 
        , <&gpio1 13 GPIO_ACTIVE_HIGH> 
        , <&gpio1 15 GPIO_ACTIVE_HIGH> 
        ;
};
